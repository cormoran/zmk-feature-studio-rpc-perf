## Kconfig
```kconfig
config ZMK_STUDIO_RPC_PERF
    bool "Enable Studio RPC performance measurement"

if ZMK_STUDIO_RPC_PERF

config ZMK_STUDIO_RPC_PERF_HANDLER
    bool "Enable Studio RPC performance measurement handler"
    depends on ZMK_STUDIO

config ZMK_STUDIO_RPC_PERF_SPLIT_RPC_RELAY
    bool "Relay Studio RPC performance requests across split halves"
    depends on ZMK_SPLIT
    select ZMK_SPLIT_RELAY_EVENT
    help
      Relays performance RPC requests from the central side to split
      peripherals, and relays performance responses back to the central side.
      Works over both the BLE and the wired (CONFIG_ZMK_SPLIT_WIRED) split
      transports -- the relay-event layer it builds on is transport agnostic.
      Increase CONFIG_ZMK_SPLIT_RELAY_EVENT_DATA_LEN to allow larger split
      performance request and response payloads.

config ZMK_STUDIO_RPC_PERF_SPLIT_TIMEOUT_MS
    int "Timeout for split performance responses in milliseconds"
    depends on ZMK_STUDIO_RPC_PERF_SPLIT_RPC_RELAY
    default 10000

endif
```

## tests/zmk-config/boards/shields/my_awesome_keyboard/Kconfig.defconfig
```kconfig
if SHIELD_MY_AWESOME_KEYBOARD

config ZMK_KEYBOARD_NAME
    default "MAK"

config ZMK_BLE
    def_bool y

config SETTINGS
    def_bool y

config MY_AWESOME_KEYBOARD_SPECIAL_FEATURE
    bool "Enable special feature for My Awesome Keyboard"

endif
```
